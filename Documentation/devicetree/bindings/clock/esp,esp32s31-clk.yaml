## Documentation/devicetree/bindings/clock/esp,esp32s31-clk.yaml
```yaml
# SPDX-License-Identifier: (GPL-2.0-only OR BSD-2-Clause)
%YAML 1.2
---
$id: http://devicetree.org/schemas/clock/esp,esp32s31-clk.yaml#
$schema: http://devicetree.org/meta-schemas/core.yaml#

title: Espressif ESP32-S31 clock controller

description:
  The ESP32-S31 clock controller reports the PLL and CPU clock trees inherited
  from firmware and controls peripheral clock muxes, dividers and gates in the
  HP_SYS_CLKRST, CNNT_SYS and LP_AON_CLKRST register blocks.

maintainers:
  - Dou Yiwen <douyiwen@espressif.com>

properties:
  compatible:
    const: esp,esp32s31-clk

  "#clock-cells":
    const: 1
    description:
      The clock index is defined in
      include/dt-bindings/clock/esp32s31.h.

  clocks:
    items:
      - description: External crystal oscillator

  clock-names:
    items:
      - const: xtal

  esp,cnnt-sys:
    $ref: /schemas/types.yaml#/definitions/phandle
    description:
      Phandle to the connectivity system controller register block.

  esp,lp-aon-clkrst:
    $ref: /schemas/types.yaml#/definitions/phandle
    description:
      Phandle to the low-power always-on clock and reset register block
      containing the CPLL and MPLL divider configurations.

required:
  - compatible
  - "#clock-cells"
  - clocks
  - clock-names
  - esp,cnnt-sys
  - esp,lp-aon-clkrst

additionalProperties: false

...
```

## Documentation/devicetree/bindings/counter/esp,esp-pcnt.yaml
```yaml
# SPDX-License-Identifier: (GPL-2.0-only OR BSD-2-Clause)
%YAML 1.2
---
$id: http://devicetree.org/schemas/counter/esp,esp-pcnt.yaml#
$schema: http://devicetree.org/meta-schemas/core.yaml#

title: Espressif Pulse Counter

maintainers:
  - Mao Shengrong <maoshengrong@espressif.com>

description: |
  Pulse counter (PCNT) on Espressif SoCs. Compatible strings are
  SoC-specific. ESP32-S31 has two instances of four 16-bit units. A
  unit can count pulses or decode quadrature on two channels. Pads are
  assigned through pinctrl; one function id per matrix input. Units
  without a board-level pinctrl route have no input.

properties:
  compatible:
    enum:
      - esp,esp32s31-pcnt

  reg:
    maxItems: 1

  interrupts:
    maxItems: 1

  clocks:
    maxItems: 1

  clock-names:
    const: apb

  resets:
    maxItems: 1

  pinctrl-0: true
  pinctrl-names:
    const: default

required:
  - compatible
  - reg
  - interrupts
  - clocks
  - clock-names
  - resets

additionalProperties: false

examples:
  - |
    #include <dt-bindings/clock/esp32s31.h>
    #include <dt-bindings/interrupt-controller/irq.h>
    #include <dt-bindings/reset/esp32s31.h>

    pcnt0: counter@20389000 {
        compatible = "esp,esp32s31-pcnt";
        reg = <0x20389000 0x100>;
        interrupts = <114 IRQ_TYPE_LEVEL_HIGH>;
        clocks = <&clk ESP_S31_CLK_PCNT0_APB>;
        clock-names = "apb";
        resets = <&rst ESP_S31_RST_PCNT0>;
    };
```

## Documentation/devicetree/bindings/mfd/esp,esp32s31-lp-aon-clkrst.yaml
```yaml
# SPDX-License-Identifier: (GPL-2.0-only OR BSD-2-Clause)
%YAML 1.2
---
$id: http://devicetree.org/schemas/mfd/esp,esp32s31-lp-aon-clkrst.yaml#
$schema: http://devicetree.org/meta-schemas/core.yaml#

title: Espressif ESP32-S31 low-power always-on clock and reset registers

description:
  The LP_AON_CLKRST register block contains low-power clock and reset controls,
  including the CPLL divider configuration consumed by the main clock
  controller.

maintainers:
  - Armando Dou <douyiwen@espressif.com>

properties:
  compatible:
    items:
      - const: esp,esp32s31-lp-aon-clkrst
      - const: syscon

  reg:
    maxItems: 1

required:
  - compatible
  - reg

additionalProperties: false

examples:
  - |
    syscon@20701000 {
        compatible = "esp,esp32s31-lp-aon-clkrst", "syscon";
        reg = <0x20701000 0x400>;
    };

...
```

## Documentation/devicetree/bindings/mmc/esp,esp32s31-dw-mshc.yaml
```yaml
# SPDX-License-Identifier: (GPL-2.0-only OR BSD-2-Clause)
%YAML 1.2
---
$id: http://devicetree.org/schemas/mmc/esp,esp32s31-dw-mshc.yaml#
$schema: http://devicetree.org/meta-schemas/core.yaml#

title: Espressif ESP32-S31 DesignWare Mobile Storage Host Controller

allOf:
  - $ref: synopsys-dw-mshc-common.yaml#

maintainers:
  - Dou Yiwen <douyiwen@espressif.com>

properties:
  compatible:
    const: esp,esp32s31-dw-mshc

  reg:
    maxItems: 1

  interrupts:
    maxItems: 1

  clocks:
    items:
      - description: Bus interface unit clock
      - description: Functional clock source

  clock-names:
    items:
      - const: biu
      - const: func_clk_src

  clock-frequency:
    description:
      Desired frequency of the DesignWare card interface unit input clock.
      The driver derives this rate from func_clk_src using the ESP32-S31
      functional clock divider.

  esp,clkrst:
    $ref: /schemas/types.yaml#/definitions/phandle
    description:
      System controller containing the SDMMC functional clock registers.

  esp,cnnt-sys:
    $ref: /schemas/types.yaml#/definitions/phandle
    description:
      Connectivity system controller containing SDMMC memory power controls.

  dma-noncoherent: true

required:
  - compatible
  - reg
  - interrupts
  - clocks
  - clock-names
  - clock-frequency
  - resets
  - reset-names
  - esp,clkrst
  - esp,cnnt-sys
  - dma-noncoherent

unevaluatedProperties: false

examples:
  - |
    mmc@20342000 {
        compatible = "esp,esp32s31-dw-mshc";
        reg = <0x20342000 0x1000>;
        interrupts = <3 4>;
        clocks = <&clk 13>, <&mpll_clk>;
        clock-names = "biu", "func_clk_src";
        clock-frequency = <50000000>;
        resets = <&rst 7>;
        reset-names = "reset";
        esp,clkrst = <&sysctl>;
        esp,cnnt-sys = <&cnnt_sys>;
        dma-noncoherent;
        bus-width = <4>;
        broken-cd;
    };
```

## arch/riscv/configs/esp32s31_minimal_defconfig
```kconfig
# CONFIG_LOCALVERSION_AUTO is not set
CONFIG_DEFAULT_HOSTNAME="esp32s31"
CONFIG_LOG_BUF_SHIFT=14
CONFIG_CC_OPTIMIZE_FOR_SIZE=y
CONFIG_EXPERT=y
# CONFIG_BUG is not set
CONFIG_BASE_SMALL=y
# CONFIG_KALLSYMS is not set
CONFIG_ARCH_ESPRESSIF=y
CONFIG_NONPORTABLE=y
CONFIG_ARCH_RV32I=y
# CONFIG_RISCV_ISA_ZBA is not set
CONFIG_RISCV_EMULATED_UNALIGNED_ACCESS=y
CONFIG_RISCV_SBI_V01=y
CONFIG_PHYS_RAM_BASE=0x50000000
CONFIG_XIP_KERNEL=y
CONFIG_XIP_PHYS_ADDR=0x40400000
# CONFIG_SECCOMP is not set
# CONFIG_STACKPROTECTOR is not set
# CONFIG_BLOCK is not set
# CONFIG_COREDUMP is not set
CONFIG_SLUB_TINY=y
CONFIG_SPARSEMEM_MANUAL=y
# CONFIG_COMPACTION is not set
# CONFIG_VM_EVENT_COUNTERS is not set
# CONFIG_SECRETMEM is not set
CONFIG_NET=y
CONFIG_PACKET=y
CONFIG_UNIX=y
CONFIG_INET=y
# CONFIG_IPV6 is not set
CONFIG_DEVTMPFS=y
CONFIG_DEVTMPFS_MOUNT=y
CONFIG_ESP32S31_CACHE=y
CONFIG_MTD=y
CONFIG_MTD_ROM=y
CONFIG_MTD_PHYSMAP=y
CONFIG_MTD_PHYSMAP_OF=y
CONFIG_NETDEVICES=y
CONFIG_STMMAC_ETH=y
CONFIG_DWMAC_ESP32S31=y
CONFIG_MOTORCOMM_PHY=y
# CONFIG_INPUT is not set
# CONFIG_VT is not set
# CONFIG_LEGACY_PTYS is not set
CONFIG_SERIAL_EARLYCON_RISCV_SBI=y
CONFIG_SERIAL_ESP32=y
CONFIG_I2C=y
CONFIG_I2C_CHARDEV=y
CONFIG_I2C_ESPRESSIF=y
CONFIG_PINCTRL=y
CONFIG_PINCTRL_ESP=y
CONFIG_GPIOLIB=y
CONFIG_GPIO_ESP=y
CONFIG_USB=y
CONFIG_USB_ANNOUNCE_NEW_DEVICES=y
CONFIG_USB_DWC2=y
CONFIG_COMMON_CLK_ESP32S31=y
CONFIG_ESP32S31_SYSTIMER=y
CONFIG_ESP_CLIC=y
CONFIG_ESP_INTMTX=y
CONFIG_RESET_ESP32S31=y
CONFIG_PHY_ESP32S31_USB=y
CONFIG_TMPFS=y
CONFIG_CRAMFS=y
CONFIG_PRINTK_TIME=y
# CONFIG_FRAME_POINTER is not set
# CONFIG_FTRACE is not set
```

## drivers/cache/Kconfig
```kconfig
# SPDX-License-Identifier: GPL-2.0
menu "Cache Drivers"

config AX45MP_L2_CACHE
	bool "Andes Technology AX45MP L2 Cache controller"
	depends on RISCV
	select RISCV_NONSTANDARD_CACHE_OPS
	help
	  Support for the L2 cache controller on Andes Technology AX45MP platforms.

config ESP32S31_CACHE
	bool "Espressif ESP32-S31 non-coherent DMA cache support"
	depends on RISCV
	select DMA_GLOBAL_POOL
	select RISCV_DMA_NONCOHERENT
	select SWIOTLB
	select RISCV_NONSTANDARD_CACHE_OPS
	help
	  DMA cache maintenance on the Espressif ESP32-S31. The chip's
	  external-memory (flash/PSRAM) L1 D-cache is not coherent with bus
	  masters such as the EMAC, and the core has no Zicbom, so cache
	  writeback/invalidate is delegated to OpenSBI via a vendor SBI ecall.

config SIFIVE_CCACHE
	bool "Sifive Composable Cache controller"
	depends on ARCH_SIFIVE || ARCH_STARFIVE
	help
	  Support for the composable cache controller on SiFive platforms.

config STARFIVE_STARLINK_CACHE
	bool "StarFive StarLink Cache controller"
	depends on RISCV
	depends on ARCH_STARFIVE
	depends on 64BIT
	select RISCV_DMA_NONCOHERENT
	select RISCV_NONSTANDARD_CACHE_OPS
	help
	  Support for the StarLink cache controller IP from StarFive.

endmenu
```

## drivers/phy/espressif/Kconfig
```kconfig
# SPDX-License-Identifier: GPL-2.0
#
# PHY drivers for Espressif platforms
#

config PHY_ESP32S31_USB
	bool "Espressif ESP32-S31 USB 2.0 PHY driver"
	depends on OF && HAS_IOMEM
	depends on ARCH_ESPRESSIF || COMPILE_TEST
	select GENERIC_PHY
	select MFD_SYSCON
	help
	  Enable this to support the USB 2.0 OTG-HS PHY on the Espressif ESP32-S31.
```

## drivers/pinctrl/espressif/Kconfig
```kconfig
# SPDX-License-Identifier: GPL-2.0-only

config PINCTRL_ESP
	tristate "Espressif pinctrl driver"
	depends on OF
	depends on ARCH_ESPRESSIF || COMPILE_TEST
	select GENERIC_PINCONF
	select GENERIC_PINCTRL_GROUPS
	select GENERIC_PINMUX_FUNCTIONS
	select MFD_SYSCON
	help
	  Say Y here to enable pin multiplexing and pin configuration for
	  Espressif SoCs, currently the ESP32-S31. This covers both the per-pad
	  IO_MUX registers, which select a pad's function and its input buffer,
	  pulls and drive strength, and the GPIO matrix, a crossbar that routes
	  any peripheral signal to any pad. GPIO_ESP depends on this driver to
	  claim lines.
```

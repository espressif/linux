## Documentation/devicetree/bindings/leds/esp,esp32s31-rmt-ws2812.yaml
```yaml
# SPDX-License-Identifier: (GPL-2.0-only OR BSD-2-Clause)
%YAML 1.2
---
$id: http://devicetree.org/schemas/leds/esp,esp32s31-rmt-ws2812.yaml#
$schema: http://devicetree.org/meta-schemas/core.yaml#

title: Single WS2812 RGB LED on ESP32-S31 RMT

maintainers:
  - Glauber Franco <gnfranco@gmail.com>

description: |
  An addressable RGB LED using one exclusive RMT TX channel. The pinctrl
  state routes the selected channel's output to the board's data pin.

properties:
  compatible:
    const: esp,esp32s31-rmt-ws2812
  reg:
    items:
      - minimum: 0
        maximum: 3
  pinctrl-names:
    items:
      - const: default
  pinctrl-0: true

required:
  - compatible
  - reg
  - pinctrl-names
  - pinctrl-0

additionalProperties: false
...
```

## Documentation/devicetree/bindings/soc/espressif/esp,esp32s31-rmt.yaml
```yaml
# SPDX-License-Identifier: (GPL-2.0-only OR BSD-2-Clause)
%YAML 1.2
---
$id: http://devicetree.org/schemas/soc/espressif/esp,esp32s31-rmt.yaml#
$schema: http://devicetree.org/meta-schemas/core.yaml#

title: Espressif ESP32-S31 RMT transmit controller

maintainers:
  - Glauber Franco <gnfranco@gmail.com>

description: |
  The RMT controller generates timed digital symbols. This experimental
  binding exposes four transmit channels with one 48-word block per channel.
  Each child consumes one channel, specified by its reg property.

properties:
  compatible:
    const: esp,esp32s31-rmt
  reg:
    maxItems: 1
  interrupts:
    maxItems: 1
  clocks:
    items:
      - description: APB interface clock
      - description: RMT symbol clock
  clock-names:
    items:
      - const: apb
      - const: rmt
  resets:
    maxItems: 1
  esp,hp-system:
    $ref: /schemas/types.yaml#/definitions/phandle
    description: HP system syscon controlling RMT memory power
  '#address-cells':
    const: 1
  '#size-cells':
    const: 0

patternProperties:
  '^led@[0-3]$':
    $ref: /schemas/leds/esp,esp32s31-rmt-ws2812.yaml#

required:
  - compatible
  - reg
  - interrupts
  - clocks
  - clock-names
  - resets
  - esp,hp-system
  - '#address-cells'
  - '#size-cells'

additionalProperties: false
...
```
